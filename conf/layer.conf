## conf/layer.conf
```bitbake
# We have a conf and classes directory, add to BBPATH
BBPATH .= ":${LAYERDIR}"

# We have recipes-* directories, add to BBFILES
BBFILES += "${LAYERDIR}/recipes-*/*/*.bb \
         ${LAYERDIR}/recipes-*/*/*.bbappend"

BBFILE_COLLECTIONS += "basler-imx8"
BBFILE_PATTERN_basler-imx8 = "^${LAYERDIR}/"
BBFILE_PRIORITY_basler-imx8 = "50"
LAYERVERSION_basler-imx8 = "1"
LAYERSERIES_COMPAT_basler-imx8 = "kirkstone"

LICENSE_PATH += "${LAYERDIR}/licenses"

# Override/extend machine configurations

# imx8mp-var-dart
KERNEL_DEVICETREE:append:imx8mp-var-dart = " \
	freescale/imx8mp-var-dart-dt8mcustomboard-basler-isi0.dtb \
	freescale/imx8mp-var-dart-dt8mcustomboard-legacy-basler-isi0.dtb \
	freescale/imx8mp-var-som-symphony-basler-isi0.dtb \
"

KERNEL_DEVICETREE:append:imx8mm-var-dart = " \
	freescale/imx8mm-var-dart-dt8mcustomboard-basler.dtb \
	freescale/imx8mm-var-dart-dt8mcustomboard-legacy-basler.dtb \
	freescale/imx8mm-var-som-symphony-basler.dtb \
"

KERNEL_DEVICETREE:append:imx8mq-var-dart = " \
	freescale/imx8mq-var-dart-dt8mcustomboard-sd-hdmi-basler.dtb \
	freescale/imx8mq-var-dart-dt8mcustomboard-sd-lvds-basler.dtb \
	freescale/imx8mq-var-dart-dt8mcustomboard-sd-lvds-hdmi-basler.dtb \
	freescale/imx8mq-var-dart-dt8mcustomboard-wifi-hdmi-basler.dtb \
	freescale/imx8mq-var-dart-dt8mcustomboard-wifi-lvds-basler.dtb \
	freescale/imx8mq-var-dart-dt8mcustomboard-wifi-lvds-hdmi-basler.dtb \
	freescale/imx8mq-var-dart-dt8mcustomboard-legacy-sd-dp-basler.dtb \
	freescale/imx8mq-var-dart-dt8mcustomboard-legacy-sd-hdmi-basler.dtb \
	freescale/imx8mq-var-dart-dt8mcustomboard-legacy-sd-lvds-basler.dtb \
	freescale/imx8mq-var-dart-dt8mcustomboard-legacy-sd-lvds-dp-basler.dtb \
	freescale/imx8mq-var-dart-dt8mcustomboard-legacy-sd-lvds-hdmi-basler.dtb \
	freescale/imx8mq-var-dart-dt8mcustomboard-legacy-wifi-dp-basler.dtb \
	freescale/imx8mq-var-dart-dt8mcustomboard-legacy-wifi-hdmi-basler.dtb \
	freescale/imx8mq-var-dart-dt8mcustomboard-legacy-wifi-lvds-basler.dtb \
	freescale/imx8mq-var-dart-dt8mcustomboard-legacy-wifi-lvds-dp-basler.dtb \
	freescale/imx8mq-var-dart-dt8mcustomboard-legacy-wifi-lvds-hdmi-basler.dtb \
"
```
